## Config.in
```kconfig
menu "Perl libraries/modules"
source "$BR2_EXTERNAL_EDUFW_PATH/package/perl-anyevent/Config.in"
source "$BR2_EXTERNAL_EDUFW_PATH/package/perl-hash-merge/Config.in"
source "$BR2_EXTERNAL_EDUFW_PATH/package/perl-ipc-run/Config.in"
source "$BR2_EXTERNAL_EDUFW_PATH/package/perl-scalar-list-utils/Config.in"
source "$BR2_EXTERNAL_EDUFW_PATH/package/perl-switch/Config.in"
source "$BR2_EXTERNAL_EDUFW_PATH/package/perl-template/Config.in"
source "$BR2_EXTERNAL_EDUFW_PATH/package/perl-template-plugin-ipaddr/Config.in"
source "$BR2_EXTERNAL_EDUFW_PATH/package/perl-yaml/Config.in"
endmenu
source "$BR2_EXTERNAL_EDUFW_PATH/package/grub2-tools/Config.in"
```

## configs/edufw_defconfig
```kconfig
BR2_TOOLCHAIN_BUILDROOT_WCHAR=y
BR2_TOOLCHAIN_BUILDROOT_CXX=y
BR2_TARGET_GENERIC_HOSTNAME="edufw"
BR2_TARGET_GENERIC_ISSUE="Welcome to EDUFW"
BR2_TARGET_GENERIC_PASSWD_MD5=y
BR2_TARGET_GENERIC_PASSWD_METHOD="md5"
BR2_TARGET_GENERIC_ROOT_PASSWD="$$1$$T.j9BjLM$$MUI9nx9f6.A1aU34Xu8u11"
BR2_ROOTFS_OVERLAY="$(BR2_EXTERNAL_EDUFW_PATH)/board/edufw/rootfs-overlay/"
BR2_ROOTFS_POST_IMAGE_SCRIPT="$(BR2_EXTERNAL_EDUFW_PATH)/board/edufw/post-image.iso.sh"
BR2_ROOTFS_POST_BUILD_SCRIPT="$(BR2_EXTERNAL_EDUFW_PATH)/board/edufw/post-build.sh"
BR2_LINUX_KERNEL=y
BR2_LINUX_KERNEL_USE_CUSTOM_CONFIG=y
BR2_LINUX_KERNEL_CUSTOM_CONFIG_FILE="$(BR2_EXTERNAL_EDUFW_PATH)/board/edufw/kernel.config"
BR2_PACKAGE_BUSYBOX_CONFIG="$(BR2_EXTERNAL_EDUFW_PATH)/board/edufw/busybox.config"
BR2_PACKAGE_BUSYBOX_SHOW_OTHERS=y
BR2_PACKAGE_DOSFSTOOLS=y
BR2_PACKAGE_DOSFSTOOLS_FATLABEL=y
BR2_PACKAGE_DOSFSTOOLS_FSCK_FAT=y
BR2_PACKAGE_DOSFSTOOLS_MKFS_FAT=y
BR2_PACKAGE_E2FSPROGS=y
BR2_PACKAGE_GENPART=y
BR2_PACKAGE_KBD=y
BR2_PACKAGE_PARTED=y
BR2_PACKAGE_PERL=y
BR2_PACKAGE_PERL_MOJOLICIOUS=y
BR2_PACKAGE_PERL_NET_SSLEAY=y
BR2_PACKAGE_PERL_URI=y
BR2_PACKAGE_PYTHON=y
BR2_PACKAGE_C_ICAP=y
BR2_PACKAGE_C_ICAP_MODULES=y
BR2_PACKAGE_CONNTRACK_TOOLS=y
BR2_PACKAGE_DHCP=y
BR2_PACKAGE_DHCP_SERVER=y
BR2_PACKAGE_DHCP_SERVER_DELAYED_ACK=y
BR2_PACKAGE_DHCP_RELAY=y
BR2_PACKAGE_DHCPCD=y
BR2_PACKAGE_ETHTOOL=y
BR2_PACKAGE_IPERF3=y
BR2_PACKAGE_IPROUTE2=y
BR2_PACKAGE_IPTABLES=y
BR2_PACKAGE_IPTRAF_NG=y
BR2_PACKAGE_NGINX=y
BR2_PACKAGE_NGINX_HTTP_SSL_MODULE=y
# BR2_PACKAGE_NGINX_HTTP_GEO_MODULE is not set
# BR2_PACKAGE_NGINX_HTTP_UWSGI_MODULE is not set
# BR2_PACKAGE_NGINX_HTTP_SCGI_MODULE is not set
# BR2_PACKAGE_NGINX_HTTP_UPSTREAM_IP_HASH_MODULE is not set
# BR2_PACKAGE_NGINX_HTTP_UPSTREAM_LEAST_CONN_MODULE is not set
# BR2_PACKAGE_NGINX_HTTP_UPSTREAM_KEEPALIVE_MODULE is not set
BR2_PACKAGE_NTP=y
BR2_PACKAGE_NTP_NTPDATE=y
BR2_PACKAGE_NTP_NTPDC=y
BR2_PACKAGE_NTP_NTPQ=y
BR2_PACKAGE_OPENSSH=y
BR2_PACKAGE_SQUID=y
BR2_PACKAGE_TCPDUMP=y
BR2_PACKAGE_AT=y
BR2_PACKAGE_LOGROTATE=y
BR2_PACKAGE_RSYSLOG=y
BR2_PACKAGE_LESS=y
BR2_PACKAGE_NANO=y
BR2_PACKAGE_NANO_TINY=y
BR2_PACKAGE_WGET=y
BR2_TARGET_ROOTFS_CPIO=y
BR2_TARGET_ROOTFS_CPIO_BZIP2=y
# BR2_TARGET_ROOTFS_TAR is not set
BR2_TARGET_GRUB2=y
BR2_PACKAGE_PERL_ANYEVENT=y
BR2_PACKAGE_PERL_TEMPLATE=y
BR2_PACKAGE_PERL_YAML=y
BR2_TARGET_GRUB2_TOOLS=y
BR2_PACKAGE_LIBOPENSSL_BIN=y
BR2_PACKAGE_DNSMASQ=y
BR2_PACKAGE_DNSMASQ_DNSSEC=y
BR2_PACKAGE_PERL_IPC_RUN=y
BR2_PACKAGE_PERL_SWITCH=y
BR2_PACKAGE_PERL_HASH_MERGE=y
BR2_PACKAGE_BERKELEYDB=y
BR2_PACKAGE_BERKELEYDB_TOOLS=y
BR2_PACKAGE_PWGEN=y
```

## configs/edufw_rpi3_defconfig
```kconfig
BR2_arm=y
BR2_cortex_a53=y
BR2_ARM_FPU_NEON_VFPV4=y
BR2_PACKAGE_HOST_LINUX_HEADERS_CUSTOM_4_9=y
BR2_TOOLCHAIN_BUILDROOT_WCHAR=y
BR2_TOOLCHAIN_BUILDROOT_CXX=y
BR2_TARGET_GENERIC_HOSTNAME="edufw"
BR2_TARGET_GENERIC_ISSUE="Welcome to EduFW"
BR2_ROOTFS_DEVICE_CREATION_DYNAMIC_MDEV=y
BR2_TARGET_GENERIC_ROOT_PASSWD="edufw1234"
BR2_SYSTEM_DHCP="eth0"
BR2_ROOTFS_OVERLAY="$(BR2_EXTERNAL_EDUFW_PATH)/board/edufw/rootfs-overlay/"
BR2_ROOTFS_POST_BUILD_SCRIPT="$(BR2_EXTERNAL_EDUFW_PATH)/board/edufw/post-build.raspi.sh"
BR2_ROOTFS_POST_IMAGE_SCRIPT="$(BR2_EXTERNAL_EDUFW_PATH)/board/edufw/post-image.raspi.sh"
BR2_ROOTFS_POST_SCRIPT_ARGS="--add-pi3-miniuart-bt-overlay"
BR2_LINUX_KERNEL=y
BR2_LINUX_KERNEL_CUSTOM_GIT=y
BR2_LINUX_KERNEL_CUSTOM_REPO_URL="https://github.com/raspberrypi/linux.git"
BR2_LINUX_KERNEL_CUSTOM_REPO_VERSION="9126e25b0934bd7bd843763310ea4b34c6e139d0"
BR2_LINUX_KERNEL_USE_CUSTOM_CONFIG=y
BR2_LINUX_KERNEL_CUSTOM_CONFIG_FILE="$(BR2_EXTERNAL_EDUFW_PATH)/board/edufw/kernel_rpi.config"
BR2_LINUX_KERNEL_DTS_SUPPORT=y
BR2_LINUX_KERNEL_INTREE_DTS_NAME="bcm2710-rpi-3-b bcm2710-rpi-cm3"
BR2_PACKAGE_BUSYBOX_CONFIG="$(BR2_EXTERNAL_EDUFW_PATH)/board/edufw/busybox.config"
BR2_PACKAGE_BUSYBOX_SHOW_OTHERS=y
BR2_PACKAGE_E2FSPROGS=y
BR2_PACKAGE_GENPART=y
BR2_PACKAGE_RPI_FIRMWARE=y
BR2_PACKAGE_KBD=y
BR2_PACKAGE_PARTED=y
BR2_PACKAGE_PERL=y
BR2_PACKAGE_PERL_MOJOLICIOUS=y
BR2_PACKAGE_PERL_NET_SSLEAY=y
BR2_PACKAGE_PERL_URI=y
BR2_PACKAGE_PYTHON=y
BR2_PACKAGE_BIND=y
BR2_PACKAGE_BIND_TOOLS=y
BR2_PACKAGE_C_ICAP=y
BR2_PACKAGE_C_ICAP_MODULES=y
BR2_PACKAGE_CONNTRACK_TOOLS=y
BR2_PACKAGE_DHCP=y
BR2_PACKAGE_DHCP_SERVER=y
BR2_PACKAGE_DHCP_SERVER_DELAYED_ACK=y
BR2_PACKAGE_DHCP_RELAY=y
BR2_PACKAGE_DHCPCD=y
BR2_PACKAGE_ETHTOOL=y
BR2_PACKAGE_IPERF3=y
BR2_PACKAGE_IPROUTE2=y
BR2_PACKAGE_IPTABLES=y
BR2_PACKAGE_IPTRAF_NG=y
BR2_PACKAGE_NGINX=y
BR2_PACKAGE_NTP=y
BR2_PACKAGE_NTP_NTPDATE=y
BR2_PACKAGE_NTP_NTPDC=y
BR2_PACKAGE_NTP_NTPQ=y
BR2_PACKAGE_OPENSSH=y
BR2_PACKAGE_SQUID=y
BR2_PACKAGE_TCPDUMP=y
BR2_PACKAGE_AT=y
BR2_PACKAGE_LOGROTATE=y
BR2_PACKAGE_RSYSLOG=y
BR2_PACKAGE_LESS=y
BR2_PACKAGE_NANO=y
BR2_PACKAGE_NANO_TINY=y
BR2_PACKAGE_WGET=y
BR2_TARGET_ROOTFS_CPIO_BZIP2=y
BR2_TARGET_ROOTFS_INITRAMFS=y
# BR2_TARGET_ROOTFS_TAR is not set
BR2_PACKAGE_HOST_DOSFSTOOLS=y
BR2_PACKAGE_HOST_GENIMAGE=y
BR2_PACKAGE_HOST_MTOOLS=y
BR2_PACKAGE_PERL_ANYEVENT=y
BR2_PACKAGE_PERL_TEMPLATE=y
BR2_PACKAGE_PERL_YAML=y
BR2_PACKAGE_LIBOPENSSL_BIN=y
BR2_PACKAGE_DNSMASQ=y
BR2_PACKAGE_DNSMASQ_DNSSEC=y
BR2_PACKAGE_PERL_IPC_RUN=y
BR2_PACKAGE_PERL_SWITCH=y
```

## package/perl-canary-stability/Config.in
```kconfig
config BR2_PACKAGE_PERL_CANARY_STABILITY
	bool "perl-canary-stability"
	help
	  canary to check perl compatibility for schmorp's modules

	  https://metacpan.org/release/Canary-Stability
```

## package/perl-hash-merge/Config.in
```kconfig
config BR2_PACKAGE_PERL_HASH_MERGE
	bool "perl-hash-merge"
	help
	  Perl Hash::Merge package
```

## package/perl-scalar-list-utils/Config.in
```kconfig
config BR2_PACKAGE_PERL_SCALAR_LIST_UTILS
	bool "perl-scalar-list-utils"
	help
	  Perl scalar list utils module
```

## package/perl-switch/Config.in
```kconfig
config BR2_PACKAGE_PERL_SWITCH
	bool "perl-switch"
	help
	  Perl Switch core package
```

## package/perl-template-plugin-ipaddr/Config.in
```kconfig
config BR2_PACKAGE_PERL_TEMPLATE_PLUGIN_IPADDR
	bool "perl-template-plugin-ipaddr"
	help
	  Template Toolkit plugin for IPAddr
```

## package/perl-template/Config.in
```kconfig
config BR2_PACKAGE_PERL_TEMPLATE
	bool "perl-template"
	help
	  Template Toolkit
```
